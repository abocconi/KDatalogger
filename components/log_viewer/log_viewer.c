#include "log_viewer.h"

#include <errno.h>
#include <inttypes.h>
#include <stdbool.h>
#include <stddef.h>
#include <stdint.h>
#include <stdio.h>
#include <string.h>
#include <sys/stat.h>

#include "esp_check.h"
#include "esp_log.h"
#include "esp_timer.h"

#include "storage_manager.h"

#define LOG_VIEWER_PATH STORAGE_MOUNT_PATH "/" LOG_VIEWER_FILE_NAME
/* Read size for the comparison; static buffer, so the check needs no heap and
 * little stack from the caller. */
#define LOG_VIEWER_COMPARE_CHUNK 1024U

/* Generated by EMBED_FILES from assets/datalogger.html (exact bytes, no NUL). */
extern const uint8_t s_page_start[] asm("_binary_datalogger_html_start");
extern const uint8_t s_page_end[] asm("_binary_datalogger_html_end");

static const char *TAG = "log_viewer";

static uint8_t s_chunk[LOG_VIEWER_COMPARE_CHUNK];

/** Whether the volume already holds exactly this page. */
static bool log_viewer_is_current(const uint8_t *page, size_t size)
{
    struct stat st;
    if (stat(LOG_VIEWER_PATH, &st) != 0 || !S_ISREG(st.st_mode) || (size_t)st.st_size != size) {
        return false;
    }

    FILE *file = fopen(LOG_VIEWER_PATH, "rb");
    if (file == NULL) {
        return false;
    }

    bool same = true;
    size_t offset = 0;
    while (same && offset < size) {
        const size_t want = (size - offset < sizeof(s_chunk)) ? size - offset : sizeof(s_chunk);
        const size_t got = fread(s_chunk, 1, want, file);
        same = (got == want) && (memcmp(s_chunk, page + offset, want) == 0);
        offset += got;
    }

    /* Read-only: a failed close loses nothing, the verdict stands. */
    (void)fclose(file);
    return same;
}

static esp_err_t log_viewer_write(const uint8_t *page, size_t size)
{
    FILE *file = fopen(LOG_VIEWER_PATH, "wb");
    ESP_RETURN_ON_FALSE(file != NULL, ESP_FAIL, TAG, "cannot create %s: errno=%d",
                        LOG_VIEWER_PATH, errno);

    const size_t written = fwrite(page, 1, size, file);
    const int close_result = fclose(file);
    if (written != size || close_result != 0) {
        /* A truncated page would open broken: better none, the next check
         * writes it again. */
        if (remove(LOG_VIEWER_PATH) != 0) {
            ESP_LOGW(TAG, "partial %s not removed: errno=%d", LOG_VIEWER_PATH, errno);
        }
        ESP_LOGE(TAG, "writing %s failed (%u of %u bytes, close %d)", LOG_VIEWER_PATH,
                 (unsigned)written, (unsigned)size, close_result);
        return ESP_FAIL;
    }

    return ESP_OK;
}

esp_err_t log_viewer_install(void)
{
    ESP_RETURN_ON_FALSE(storage_manager_get_owner() == STORAGE_OWNER_FIRMWARE,
                        ESP_ERR_INVALID_STATE, TAG, "storage is not owned by firmware");

    const size_t size = (size_t)(s_page_end - s_page_start);
    if (log_viewer_is_current(s_page_start, size)) {
        return ESP_OK;
    }

    const int64_t start_us = esp_timer_get_time();
    ESP_RETURN_ON_ERROR(log_viewer_write(s_page_start, size), TAG, "viewer page not written");

    /* Read back: a page that opens broken is worse than no page, and a bad
     * copy would otherwise sit there until the next firmware update. */
    if (!log_viewer_is_current(s_page_start, size)) {
        if (remove(LOG_VIEWER_PATH) != 0) {
            ESP_LOGW(TAG, "bad %s not removed: errno=%d", LOG_VIEWER_PATH, errno);
        }
        ESP_LOGE(TAG, "%s read back different from what was written", LOG_VIEWER_PATH);
        return ESP_FAIL;
    }

    ESP_LOGI(TAG, "%s written: %u bytes in %" PRId64 " ms", LOG_VIEWER_PATH, (unsigned)size,
             (esp_timer_get_time() - start_us) / 1000);
    return ESP_OK;
}
